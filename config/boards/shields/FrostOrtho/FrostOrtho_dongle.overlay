#include "FrostOrtho.dtsi"

/ {
    chosen {
        zmk,kscan = &mock_kscan;
    };

    // ドングル本体には物理ボタンがないので「空の入力」を定義
    mock_kscan: kscan_1 {
        compatible = "zmk,kscan-mock";
        columns = <0>;
        rows = <0>;
        events = <0>;
    };
};
## config/boards/shields/FrostOrtho/Kconfig.defconfig
```kconfig
if SHIELD_FROSTORTHO_R

config ZMK_KEYBOARD_NAME
    default "FrostOrtho_R"

config ZMK_SPLIT
    default y


endif

if SHIELD_FROSTORTHO_L

config ZMK_KEYBOARD_NAME
    default "FrostOrtho_L"

config ZMK_SPLIT
    default y

endif

if SHIELD_FROSTORTHO_DONGLE

config ZMK_KEYBOARD_NAME
    default "FrostOrtho_dongle"

config ZMK_SPLIT
        default y

    config ZMK_SPLIT_ROLE_CENTRAL
        default y

    config ZMK_SPLIT_BLE_CENTRAL_PERIPHERALS
        default 2

endif
```

## config/boards/shields/FrostOrtho/Kconfig.shield
```kconfig
config SHIELD_FROSTORTHO_R
    def_bool $(shields_list_contains,FrostOrtho_R)

config SHIELD_FROSTORTHO_L
    def_bool $(shields_list_contains,FrostOrtho_L)

config SHIELD_FROSTORTHO_DONGLE
    def_bool $(shields_list_contains,frostortho_dongle)
```

## config/west.yml
```yaml
manifest:
  remotes:
    - name: zmkfirmware
      url-base: https://github.com/zmkfirmware
    - name: caksoylar
      url-base: https://github.com/caksoylar
    - name: cormoran
      url-base: https://github.com/cormoran
    - name: zmkfirmware
      url-base: https://github.com/zmkfirmware
    - name: carrefinho
      url-base: https://github.com/carrefinho
    - name: janpfischer
      url-base: https://github.com/janpfischer
    - name: sekigon-gonnoc  # PAW3222
      url-base: https://github.com/sekigon-gonnoc  

  projects:
    - name: zmk
      remote: zmkfirmware
      revision: v0.3.0
      import: app/west.yml
    - name: zmk-driver-paw3222
      remote: sekigon-gonnoc
      revision: main
    - name: zmk-rgbled-widget
      remote: caksoylar
      revision: v0.3.0
    - name: zmk-dongle-screen
      remote: janpfischer
      revision: main

  self:
    path: config
```
